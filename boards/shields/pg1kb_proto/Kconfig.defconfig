## boards/shields/pg1kb_proto/Kconfig.defconfig
```kconfig
if SHIELD_PG1KB_PROTO_LEFT

config ZMK_KEYBOARD_NAME
    default "PG1KB Proto"

config ZMK_SPLIT_ROLE_CENTRAL
    default n

config INPUT
    bool
    default y

config PMW3610
    bool
    default y

config SPI
    bool
    default y

config ZMK_POINTING
    bool
    default y

endif

if SHIELD_PG1KB_PROTO_RIGHT

config ZMK_KEYBOARD_NAME
    default "PG1KB Proto"

config ZMK_SPLIT_ROLE_CENTRAL
    default y

config INPUT
    bool
    default y

config PAW3222
    bool
    default y

config SPI
    bool
    default y

config ZMK_BLE
    bool
    default y

config ZMK_USB
    bool
    default y

config ZMK_POINTING
    bool
    default y

endif

if SHIELD_PG1KB_PROTO_LEFT || SHIELD_PG1KB_PROTO_RIGHT

config ZMK_SPLIT
    default y

endif
```

## west.yml
```yaml
manifest:
  remotes:
    - name: sekigon-gonnoc
      url-base: https://github.com/sekigon-gonnoc
  projects:
    - name: zmk-driver-paw3222
      remote: sekigon-gonnoc
      revision: main
```
